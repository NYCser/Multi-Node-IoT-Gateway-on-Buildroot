## buildroot/package/python-flask-socketio/Config.in
```kconfig
config BR2_PACKAGE_PYTHON_FLASK_SOCKETIO
    bool "python-flask-socketio"
    select BR2_PACKAGE_PYTHON_FLASK
    select BR2_PACKAGE_PYTHON_SOCKETIO
    help
      Flask integration for Socket.IO.

      https://github.com/miguelgrinberg/Flask-SocketIO
```
